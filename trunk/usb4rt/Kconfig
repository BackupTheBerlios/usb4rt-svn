## trunk/usb4rt/Kconfig
```kconfig
config MODULES
    bool
    default y

config USB4RT_VERSION
    string
    default "0.0.5"

menu "General"

config USB4RT_BANDW_RECLAM
    bool "Bandwidth Reclamation"
    default y
    help

config USB4RT_LINUXDIR
    string "Linux source directory"
    default "/usr/src/linux"
    help

config USB4RT_XENOMAIDIR
    string "Xenomai install tree"
    default "/usr/xenomai"
    help
    This variable contains the directory where was installed your
    Xenomai. As explained before, you can change the value
    of the Xenomai build tree which is fixed by default to
    /usr/xenomai i.e. the install directory of the running Xenomai.

config USB4RT_INSTALLDIR
    string "USB4RT installation Directory"
    default "/usr/local/usb4rt"
    help

endmenu

menu "Debugging"

config USB4RT_DBG_COMMON
    bool "Common"
    default y
    help

config USB4RT_DBG_TIME
    bool "Timing"
    default n
    help

config USB4RT_DBG_TD
    bool "Transfer descriptors"
    default n
    help

config USB4RT_DBG_QH
    bool "Queue heads"
    default n
    help

endmenu
```

## trunk/usb4rt/apps/Kconfig
```kconfig
menu "Applications"

config USB4RT_APP_PING
    bool "Realtime USB ping module"
    default y
    help
    Realtime USB ping module. You can test the realtime USB connection to any USB devices with this module.
    More information are in the README file in the root directory of usb4rt.

endmenu
```

## trunk/usb4rt/drivers/Kconfig
```kconfig
menu "Drivers"

config USB4RT_DRV_FTDI_SIO
    bool "FTDI Serial Converter (under construction)"
    default n
    help
    Realtime driver for the FTDI usb to serial converter (under construction).

endmenu
```
